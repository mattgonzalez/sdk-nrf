## Kconfig.defaults
```
#
# Copyright (c) 2022 Nordic Semiconductor ASA
#
# SPDX-License-Identifier: LicenseRef-Nordic-5-Clause
#

config REBOOT
	default y

config MAIN_THREAD_PRIORITY
	default 10

config MAIN_STACK_SIZE
	default 1400

config SYSTEM_WORKQUEUE_STACK_SIZE
	default 1200

# As long as thread names are used, config must be set to "y"
config THREAD_NAME
	default y

config NCS_INCLUDE_RPMSG_CHILD_IMAGE
	default n

# Workaround to not use fatal_error.c in NCS. Note that the system may still
# reset on error depending on the build configuraion
config RESET_ON_FATAL_ERROR
	default n

# Default Config for Debug and Release build
config HW_CODEC_CIRRUS_LOGIC
	default y

config BT
	default y

config BOARD_ENABLE_DCDC_APP
	default y

config BOARD_ENABLE_DCDC_NET
	default y

config BOARD_ENABLE_CPUNET
	default y

config NFCT_PINS_AS_GPIOS
	default y

config ZBUS
	default y

config ZBUS_RUNTIME_OBSERVERS_POOL_SIZE
	default 2

config SENSOR
	default y

config REGULATOR
	default y

config CONTIN_ARRAY
	default y

config NRFX_I2S
	default y

config PCM_MIX
	default y

config TONE
	default y

config PSCM
	default y

config DATA_FIFO
	default y

# Enable NRFX_CLOCK for ACLK control
config NRFX_CLOCK
	default y

config I2C
	default y

choice LIBC_IMPLEMENTATION
	# NOTE: Since we are not using minimal libc, error codes from
	#       minimal libc are not used
	default NEWLIB_LIBC
endchoice

# Audio codec LC3 related defines
# FPU_SHARING enables preservation of the hardware floating point registers
# across context switches to allow multiple threads to perform concurrent
# floating point operations.
config FPU
	default y

config FPU_SHARING
	default y

# Enable SDHC interface
config DISK_DRIVERS
	default n

config DISK_DRIVER_SDMMC
	default y

# Enable SPI interface
config SPI
	default y

# Enable ADC for board version readback
config ADC
	default y

# Allocate buffer on RAM for transferring chunck of data
# from Flash to SPI
config SPI_NRFX_RAM_BUFFER_SIZE
	default 8

# Config the file system
config FILE_SYSTEM
	default y

config FAT_FILESYSTEM_ELM
	default y

config FS_FATFS_LFN
	default y
choice FS_FATFS_LFN_MODE
	# Using stack for LFN work queue
	default FS_FATFS_LFN_MODE_STACK
endchoice

# exFAT enabled to support longer file names and higher transfer speed
config FS_FATFS_EXFAT
	default y

# Set the maximum file name length to 255
config FS_FATFS_MAX_LFN
	default 255

config MCUBOOT_SERIAL
	default n

config BT_LL_ACS_NRF53
	default y
```

## prj.conf
```kconfig
#
# Copyright (c) 2022 Nordic Semiconductor ASA
#
# SPDX-License-Identifier: LicenseRef-Nordic-5-Clause
#

# nRF5340 Audio
CONFIG_NRF5340_AUDIO=y
CONFIG_STREAM_BIDIRECTIONAL=n
CONFIG_HW_CODEC_CIRRUS_LOGIC=n
CONFIG_AUDIO_SOURCE_I2S=y
CONFIG_BOARD_ENABLE_DCDC_APP=n
CONFIG_BOARD_ENABLE_DCDC_NET=n
CONFIG_BOARD_ENABLE_DCDC_HV=n
CONFIG_ADC=n
CONFIG_BT_PRIVACY=n
CONFIG_AUDIO_BIT_DEPTH_16=n
CONFIG_AUDIO_BIT_DEPTH_32=y
CONFIG_BT_DEVICE_NAME="ECHO AIO-BT LE"
CONFIG_BT_DEVICE_NAME_DYNAMIC=y

# CONFIG_BT_ISO_BROADCAST=n
# Security
# CONFIG_SECURE_BOOT=y
# CONFIG_SB_SIGNING_KEY_FILE="C:/ncs/nrf5340_audio/src/ECHO_BT_SECURE_SIGN_KEY_PRIVATE.pem"
# CONFIG_SB_PUBLIC_KEY_FILES="C:/Users/milo/proj/AIO/AIO_BT_Module/nrf5340_audio/src/ECHO_BT_SECURE_SIGN_KEY_PUBLIC.pem"

# General
CONFIG_DEBUG=y
CONFIG_DEBUG_INFO=y
CONFIG_ASSERT=y
CONFIG_STACK_USAGE=y
CONFIG_THREAD_RUNTIME_STATS=y
CONFIG_STACK_SENTINEL=y
CONFIG_INIT_STACKS=y

# Uart driver
CONFIG_SERIAL=y

# Logging
CONFIG_LOG=y
CONFIG_NEWLIB_LIBC_FLOAT_PRINTF=y
CONFIG_LOG_TAG_MAX_LEN=2
CONFIG_LOG_TAG_DEFAULT="--"
CONFIG_BOOT_BANNER=n
CONFIG_BT_AUDIO_DEBUG_UNICAST_CLIENT=y
CONFIG_BT_SCAN_LOG_LEVEL_DBG=y
CONFIG_BT_AUDIO_STREAM_LOG_LEVEL_WRN=y
CONFIG_BT_AUDIO_STREAM_LOG_LEVEL_ERR=y
CONFIG_BT_AUDIO_STREAM_LOG_LEVEL_DBG=y
CONFIG_BT_AUDIO_DEBUG_STREAM=y
CONFIG_LOG_BUFFER_SIZE=8192

# For Earfun Pro 3
# CONFIG_BT_AUDIO_PRESENTATION_DELAY_US=25000
# CONFIG_BT_AUDIO_MAX_TRANSPORT_LATENCY_MS=30

# Console related defines
CONFIG_CONSOLE=y
CONFIG_UART_CONSOLE=y
# Enable console with mcumgr pass through
CONFIG_UART_CONSOLE_MCUMGR=y
CONFIG_MCUMGR_SMP_SHELL=y

# Shell related defines
CONFIG_SHELL=y
CONFIG_KERNEL_SHELL=n
CONFIG_USE_SEGGER_RTT=n
CONFIG_SHELL_PROMPT_UART=""
CONFIG_SHELL_MINIMAL=y

## Disable logs on RTT
CONFIG_SHELL_BACKEND_RTT=n
CONFIG_SHELL_BACKEND_SERIAL=y
CONFIG_SHELL_VT100_COMMANDS=n
CONFIG_SHELL_VT100_COLORS=n
CONFIG_SHELL_STACK_SIZE=4096
CONFIG_SHELL_CMD_BUFF_SIZE=128

## Reduce shell memory usage
CONFIG_SHELL_WILDCARD=n
CONFIG_SHELL_HELP_ON_WRONG_ARGUMENT_COUNT=n
CONFIG_SHELL_STATS=n
CONFIG_SHELL_CMDS=n
CONFIG_SHELL_HISTORY=y
# CONFIG_SHELL_MINIMAL=y

# Turn off default shell commands
CONFIG_I2C_SHELL=n
CONFIG_HWINFO_SHELL=n
CONFIG_CLOCK_CONTROL_NRF_SHELL=n
CONFIG_FLASH_SHELL=n
CONFIG_DEVICE_SHELL=y
CONFIG_ADC_SHELL=n
CONFIG_DEVMEM_SHELL=n
CONFIG_MCUBOOT_SHELL=y
CONFIG_SENSOR_SHELL=n
CONFIG_STATS_SHELL=n

# Disable Cirrus Codec, and I2C which are not used on echo_aio_bt
CONFIG_HW_CODEC_CIRRUS_LOGIC=n
CONFIG_SENSOR=n
CONFIG_I2C=y
CONFIG_DISK_DRIVERS=n
CONFIG_DISK_DRIVER_SDMMC=n

CONFIG_MCUMGR_SMP_BT=n
CONFIG_MCUMGR_SMP_UART=n

# Enable mcumgr.
CONFIG_MCUMGR=y
CONFIG_MCUMGR_CMD_IMG_MGMT=y
CONFIG_MCUMGR_CMD_SHELL_MGMT=y
CONFIG_MCUMGR_CMD_OS_MGMT=y
```

## prj_release.conf
```kconfig
#
# Copyright (c) 2022 Nordic Semiconductor ASA
#
# SPDX-License-Identifier: LicenseRef-Nordic-5-Clause
#

# nRF5340 Audio
CONFIG_NRF5340_AUDIO=y
CONFIG_STREAM_BIDIRECTIONAL=y
CONFIG_HW_CODEC_CIRRUS_LOGIC=n
CONFIG_AUDIO_SOURCE_I2S=y
CONFIG_BOARD_ENABLE_DCDC_APP=n
CONFIG_BOARD_ENABLE_DCDC_NET=n
CONFIG_BOARD_ENABLE_DCDC_HV=n
CONFIG_ADC=n
CONFIG_BT_PRIVACY=n
CONFIG_AUDIO_BIT_DEPTH_16=n
CONFIG_AUDIO_BIT_DEPTH_32=y
CONFIG_BT_DEVICE_NAME="ECHO AIO-BT LE"
CONFIG_BT_DEVICE_NAME_DYNAMIC=y

# CONFIG_BT_ISO_BROADCAST=n
# Security
# CONFIG_SECURE_BOOT=y
# CONFIG_SB_SIGNING_KEY_FILE="C:/ncs/nrf5340_audio/src/ECHO_BT_SECURE_SIGN_KEY_PRIVATE.pem"
# CONFIG_SB_PUBLIC_KEY_FILES="C:/Users/milo/proj/AIO/AIO_BT_Module/nrf5340_audio/src/ECHO_BT_SECURE_SIGN_KEY_PUBLIC.pem"

# General
CONFIG_DEBUG=n
CONFIG_DEBUG_INFO=n
CONFIG_ASSERT=y
CONFIG_STACK_USAGE=y
CONFIG_THREAD_RUNTIME_STATS=n
CONFIG_STACK_SENTINEL=y
CONFIG_INIT_STACKS=y

# Uart driver
CONFIG_SERIAL=y

# Logging
CONFIG_LOG=y
CONFIG_NEWLIB_LIBC_FLOAT_PRINTF=n
CONFIG_LOG_TAG_MAX_LEN=2
CONFIG_LOG_TAG_DEFAULT="--"
CONFIG_BOOT_BANNER=n
CONFIG_BT_AUDIO_DEBUG_UNICAST_CLIENT=n
CONFIG_BT_SCAN_LOG_LEVEL_DBG=n
CONFIG_BT_AUDIO_STREAM_LOG_LEVEL_DBG=n
CONFIG_BT_AUDIO_DEBUG_STREAM=n
CONFIG_LOG_BUFFER_SIZE=8192

# For Earfun Pro 3
# CONFIG_BT_AUDIO_PRESENTATION_DELAY_US=25000
# CONFIG_BT_AUDIO_MAX_TRANSPORT_LATENCY_MS=30

# Console related defines
CONFIG_CONSOLE=y
CONFIG_UART_CONSOLE=y
# Enable console with mcumgr pass through
CONFIG_UART_CONSOLE_MCUMGR=y
CONFIG_MCUMGR_SMP_SHELL=y

# Shell related defines
CONFIG_SHELL=y
CONFIG_KERNEL_SHELL=n
CONFIG_USE_SEGGER_RTT=n
CONFIG_SHELL_PROMPT_UART=""
CONFIG_SHELL_MINIMAL=y

## Disable logs on RTT
CONFIG_SHELL_BACKEND_RTT=n
CONFIG_SHELL_BACKEND_SERIAL=y
CONFIG_SHELL_VT100_COMMANDS=n
CONFIG_SHELL_VT100_COLORS=n
CONFIG_SHELL_STACK_SIZE=4096
CONFIG_SHELL_CMD_BUFF_SIZE=128

## Reduce shell memory usage
CONFIG_SHELL_WILDCARD=n
CONFIG_SHELL_HELP_ON_WRONG_ARGUMENT_COUNT=n
CONFIG_SHELL_STATS=n
CONFIG_SHELL_CMDS=n
CONFIG_SHELL_HISTORY=y
# CONFIG_SHELL_MINIMAL=y

# Turn off default shell commands
CONFIG_I2C_SHELL=n
CONFIG_HWINFO_SHELL=n
CONFIG_CLOCK_CONTROL_NRF_SHELL=n
CONFIG_FLASH_SHELL=n
CONFIG_DEVICE_SHELL=y
CONFIG_ADC_SHELL=n
CONFIG_DEVMEM_SHELL=n
CONFIG_MCUBOOT_SHELL=y
CONFIG_SENSOR_SHELL=n
CONFIG_STATS_SHELL=n

# Disable Cirrus Codec, I2C, and SPI which are not used on echo_aio_bt
CONFIG_HW_CODEC_CIRRUS_LOGIC=n
CONFIG_SENSOR=n
CONFIG_I2C=y
CONFIG_SPI=n
CONFIG_DISK_DRIVERS=n
CONFIG_DISK_DRIVER_SDMMC=n

CONFIG_MCUMGR_SMP_BT=n
CONFIG_MCUMGR_SMP_UART=n

# Enable mcumgr.
CONFIG_MCUMGR=y
CONFIG_MCUMGR_CMD_IMG_MGMT=y
CONFIG_MCUMGR_CMD_SHELL_MGMT=y
CONFIG_MCUMGR_CMD_OS_MGMT=y
```

## src/main.c
```c
/*
 * Copyright (c) 2018 Nordic Semiconductor ASA
 *
 * SPDX-License-Identifier: LicenseRef-Nordic-5-Clause
 */

#include "echo_aio_bt.h"
#include <zephyr/kernel.h>
#include <zephyr/debug/stack.h>
#include <zephyr/device.h>
#include <string.h>

#include <zephyr/bluetooth/bluetooth.h>
#include <zephyr/bluetooth/hci.h>
#include <zephyr/settings/settings.h>
#include <zephyr/zbus/zbus.h>

#include "macros_common.h"
#include "fw_info_app.h"
#include "led.h"
#include "button_handler.h"
#include "button_assignments.h"
#include "nrfx_clock.h"
#include "ble_core.h"
#include "audio_system.h"
#include "channel_assignment.h"
#include "streamctrl.h"
#include <hal/nrf_gpio.h>

#if defined(CONFIG_AUDIO_DFU_ENABLE)
#include "dfu_entry.h"
#endif

#include <zephyr/logging/log.h>
LOG_MODULE_REGISTER(main, CONFIG_MAIN_LOG_LEVEL);

#if defined(CONFIG_INIT_STACKS)
/* Used for printing stack usage */
extern struct k_thread z_main_thread;
#endif /* defined(CONFIG_INIT_STACKS) */

static atomic_t ble_core_is_ready = (atomic_t) false;

ZBUS_CHAN_DECLARE(button_chan);
ZBUS_CHAN_DECLARE(le_audio_chan);

ZBUS_OBS_DECLARE(button_sub);
ZBUS_OBS_DECLARE(le_audio_evt_sub);

static int hfclock_config_and_start(void)
{
	int ret;

	/* Use this to turn on 128 MHz clock for cpu_app */
	ret = nrfx_clock_divider_set(NRF_CLOCK_DOMAIN_HFCLK, NRF_CLOCK_HFCLK_DIV_1);

	ret -= NRFX_ERROR_BASE_NUM;
	if (ret) {
		return ret;
	}

	nrfx_clock_hfclk_start();
	while (!nrfx_clock_hfclk_is_running()) {
	}

	return 0;
}

static int leds_set(void)
{
	int ret;

	/* Blink LEDs 1 and 3 to indicate that APP core is running */
	ret = led_blink(LED_APP_3_GREEN);
	if (ret) {
		return ret;
	}
	ret = led_blink(LED_APP_2_GREEN);
	if (ret) {
		return ret;
	}

#if (CONFIG_AUDIO_DEV == HEADSET)
	enum audio_channel channel;

	channel_assignment_get(&channel);

	if (channel == AUDIO_CH_L) {
		ret = led_on(LED_APP_RGB, LED_COLOR_BLUE);
	} else {
		ret = led_on(LED_APP_RGB, LED_COLOR_MAGENTA);
	}

	if (ret) {
		return ret;
	}
#elif (CONFIG_AUDIO_DEV == GATEWAY)
	ret = led_on(LED_APP_RGB, LED_COLOR_GREEN);
	if (ret) {
		return ret;
	}
#endif /* (CONFIG_AUDIO_DEV == HEADSET) */

	return 0;
}

static int channel_assign_check(void)
{
#if (CONFIG_AUDIO_DEV == HEADSET) && CONFIG_AUDIO_HEADSET_CHANNEL_RUNTIME
	int ret;
	bool pressed;

	ret = button_pressed(BUTTON_VOLUME_DOWN, &pressed);
	if (ret) {
		return ret;
	}

	if (pressed) {
		channel_assignment_set(AUDIO_CH_L);
		return 0;
	}

	ret = button_pressed(BUTTON_VOLUME_UP, &pressed);
	if (ret) {
		return ret;
	}

	if (pressed) {
		channel_assignment_set(AUDIO_CH_R);
		return 0;
	}
#endif

	return 0;
}

/* Callback from ble_core when the ble subsystem is ready */
void on_ble_core_ready(void)
{
	int ret;

	(void)atomic_set(&ble_core_is_ready, (atomic_t) true);

	if (IS_ENABLED(CONFIG_SETTINGS)) {
		settings_load();

		ret = bonding_clear_check();
		ERR_CHK(ret);
	}
}

int main(void)
{
	int ret;
	char name[LOCAL_NAME_MAX] = { 0 };

	LOG_DBG("nRF5340 APP core started");

	ret = hfclock_config_and_start();
	ERR_CHK(ret);

	ret = led_init();
	ERR_CHK(ret);

	if (IS_ENABLED(CONFIG_ZBUS) && (CONFIG_ZBUS_RUNTIME_OBSERVERS_POOL_SIZE > 0)) {
		ret = zbus_chan_add_obs(&button_chan, &button_sub, K_MSEC(200));
		ERR_CHK(ret);

		ret = zbus_chan_add_obs(&le_audio_chan, &le_audio_evt_sub, K_MSEC(200));
		ERR_CHK(ret);
	}

	ret = button_handler_init();
	ERR_CHK(ret);

	channel_assignment_init();

	ret = channel_assign_check();
	ERR_CHK(ret);

	ret = fw_info_app_print();
	ERR_CHK(ret);


	/* Initialize BLE, with callback for when BLE is ready */
	ret = ble_core_init(on_ble_core_ready);
	ERR_CHK(ret);

	/* Wait until ble_core/NET core is ready */
	while (!(bool)atomic_get(&ble_core_is_ready)) {
		(void)k_sleep(K_MSEC(100));
	}

	// Setup and set local BT name
	snprintf(name, sizeof name, "%s_%6X", LOCAL_NAME, NRF_FICR->INFO.DEVICEID[0] & 0xffffff);
	LOG_INF("Local name: %s", name);
	ret = bt_set_name(name);
	if (ret) 
		LOG_WRN("Unable to set name %s (ret %d)", name, ret);

	ret = leds_set();
	ERR_CHK(ret);

	ret = streamctrl_start();
	ERR_CHK(ret);
}
```
